## conf/layer.conf
```bitbake
# SPDX-License-Identifier: MIT
# We have a conf and classes directory, add to BBPATH
BBPATH .= ":${LAYERDIR}"

# We have recipes-* directories, add to BBFILES
BBFILES += "${LAYERDIR}/recipes-*/*/*.bb \
            ${LAYERDIR}/recipes-*/*/*.bbappend"

BBFILE_COLLECTIONS += "meta-elos"
BBFILE_PATTERN_meta-elos = "^${LAYERDIR}/"
BBFILE_PRIORITY_meta-elos = "5"

# We need the core layer (naturally) and meta-oe from openembedded for cmocka
LAYERDEPENDS_meta-elos = "core"
LAYERSERIES_COMPAT_meta-elos = "kirkstone"

META_ELOS_SRC_REPO_BASE ?= "git://github.com/Elektrobit"
META_ELOS_SRC_REPO_PROTOCOL_PARAM ?= ";protocol=https"
```
